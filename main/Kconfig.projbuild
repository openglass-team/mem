## main/Kconfig.projbuild
```kconfig
menu "Audio Streaming Configuration"

    config WIFI_SSID
        string "Wi-Fi SSID"
        default "myssid"
        help
            SSID (network name) for the Wi-Fi station to connect to.

    config WIFI_PASSWORD
        string "Wi-Fi Password"
        default "mypassword"
        help
            Password for the Wi-Fi network.

    config WSS_URL
        string "WebSocket Server URL"
        default "wss://openspeech.bytedance.com/api/v3/sauc/bigmodel"
        help
            Volcengine (火山引擎) streaming ASR WebSocket endpoint.
            See: https://docs.volcengine.com/docs/6561/1354869

    config VC_API_KEY
        string "Volcengine App ID (X-Api-App-Key)"
        default ""
        help
            Volcengine App ID for X-Api-App-Key HTTP header.
            This is the numeric APP ID from the Volcengine Console.

    config VC_ACCESS_KEY
        string "Volcengine Access Token (X-Api-Access-Key)"
        default ""
        help
            Volcengine Access Token for X-Api-Access-Key HTTP header.

    config WSS_SKIP_CERT_VERIFY
        bool "Skip TLS certificate verification (testing only)"
        default y
        help
            Skip server certificate verification for WSS connections.
            Enable this for development/testing. Disable for production.

    choice AUDIO_SAMPLE_RATE
        prompt "Audio Sample Rate"
        default AUDIO_SAMPLE_RATE_16000
        help
            Audio sampling rate in Hz.

        config AUDIO_SAMPLE_RATE_8000
            bool "8000 Hz"
        config AUDIO_SAMPLE_RATE_16000
            bool "16000 Hz"
        config AUDIO_SAMPLE_RATE_24000
            bool "24000 Hz"
    endchoice

    config AUDIO_SAMPLE_RATE_HZ
        int
        default 8000 if AUDIO_SAMPLE_RATE_8000
        default 16000 if AUDIO_SAMPLE_RATE_16000
        default 24000 if AUDIO_SAMPLE_RATE_24000

    config AUDIO_FRAME_DURATION_MS
        int "Audio frame duration (ms)"
        range 5 60
        default 20
        help
            Duration of each audio frame in milliseconds.
            Standard Opus values: 2.5, 5, 10, 20, 40, 60 ms.
            Default 20ms gives a good balance of latency and efficiency.

    config OPUS_BITRATE_BPS
        int "Opus encoder bitrate (bps)"
        range 8000 64000
        default 32000
        help
            Target bitrate for Opus encoding.
            16000 = low quality voice, 32000 = good voice,
            48000 = high quality, 64000 = music quality.

    config OPUS_COMPLEXITY
        int "Opus encoder complexity"
        range 0 10
        default 5
        help
            Opus encoder computational complexity.
            0 = fastest/lowest quality, 10 = slowest/highest quality.
            5 is a good balance for ESP32-S3.

    config VAD_ENERGY_THRESHOLD
        int "VAD energy threshold (RMS)"
        range 1 100000
        default 500
        help
            RMS energy threshold for voice activity detection.
            Signals above this threshold are considered speech.
            Lower = more sensitive. Tune based on your microphone.

    config VAD_HANGOVER_MS
        int "VAD hangover time (ms)"
        range 0 1000
        default 300
        help
            How long to keep VAD in SPEAKING state after energy drops below threshold.
            Prevents cutting off the end of words.

    config AUDIO_SEND_QUEUE_SIZE
        int "Send queue size (packets)"
        range 4 64
        default 16
        help
            Maximum number of Opus packets queued for WebSocket sending.

    config CLOUD_UPLOAD_URL
        string "Cloud Upload URL (BOS endpoint)"
        default "https://your-bucket.bj.bce.baidubce.com"
        help
            Baidu BOS (Object Storage) endpoint URL for uploading .txt documents.
            Format: https://{bucket}.{region}.bce.baidubce.com
            Object key will be appended as /{prefix}{filename}.txt

    config CLOUD_UPLOAD_PATH_PREFIX
        string "Upload path prefix"
        default "asr_logs/"
        help
            Path prefix for uploaded ASR documents on the cloud storage.
            Files will be named: {prefix}asr_YYYYMMDD_HHMMSS.txt

endmenu
```
